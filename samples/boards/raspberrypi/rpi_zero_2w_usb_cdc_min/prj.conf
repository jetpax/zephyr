## prj.conf
```kconfig
# USB device stack (new / device_next)
CONFIG_USB_DEVICE_STACK_NEXT=y
CONFIG_UDC_DWC2=y

# Force PIO mode. The driver defaults UDC_DWC2_DMA=y when the chip
# advertises Internal DMA in GHWCFG2.OtgArch (BCM2710 does, value=2),
# but on this Apple Silicon host the driver's DMA path is unsafe:
# it writes the buffer's virtual address (32-bit truncated) to
# DOEPDMA and assumes the controller can use it as a physical
# address, and does no cache maintenance for the AHB master's
# accesses to the buffer. Identity-mapped RAM masks the VA/PA
# issue, but cache coherency would still cause silent data
# corruption. Phase 2.1 of the bring-up turned this up. PIO is
# the simpler / correct path for first enumeration; DMA mode is a
# sequel that needs CONFIG_CACHE_MANAGEMENT and a real driver-side
# coherency strategy.
CONFIG_UDC_DWC2_DMA=n

# CDC ACM class — turnkey init at SYS_INIT (no manual usbd_init/enable
# required; the class brings the stack up by itself).
CONFIG_SERIAL=y
CONFIG_USBD_CDC_ACM_CLASS=y
CONFIG_CDC_ACM_SERIAL_INITIALIZE_AT_BOOT=y

# VideoCore mailbox + firmware property-tag interface. Required by
# the DWC2 vendor pre_enable hook to power on the USB analog PHY
# island (Phase 2.4 -- without this VC leaves the island off and
# D+/D- aren't electrically driven even though the controller's MMIO
# is fully accessible). BCM2835_FIRMWARE default-y picks these up
# once the &mailbox / &firmware nodes are enabled in the overlay.
CONFIG_BCM2835_MBOX=y
CONFIG_BCM2835_FIRMWARE=y

# HWINFO via VC firmware property GET_BOARD_SERIAL. USBD framework
# fills the iSerialNumber string descriptor from hwinfo_get_device_id;
# without this, the Mac STALL-spams trying to retrieve string idx 3
# during enumeration (the device works anyway, but every boot log
# has 3-4 "HWINFO not implemented or enabled" protocol-error lines).
# HWINFO_BCM2835 default-y depends on BCM2835_FIRMWARE + SOC_BCM2710.
CONFIG_HWINFO=y

# USB stack thread stacks. Upstream defaults (USBD=1024, UDC_DWC2=512)
# are tight for AArch64; the DIN-event call chain (DWC2 ISR ->
# usbd_thread -> usbd_ch9 -> CDC ACM class -> LOG_INF) blows past
# them and the resulting overflow scribbles a function-pointer-shaped
# value onto the saved LR slot, so RET dispatches into .rodata =
# PXN fault. Same family as memory reference_zephyr_net_thread_stack_
# sizes (brcmfmac TCP workq bump). 4 KiB is generous but cheap in
# our 256 MiB RAM budget.
CONFIG_USBD_THREAD_STACK_SIZE=4096
CONFIG_UDC_DWC2_STACK_SIZE=4096

# Stack sentinel: writes a magic value at the bottom of every
# thread's stack and ASSERTs if it's clobbered. Catches overflow
# at the moment of the overwrite (or shortly after, at the next
# thread switch / check point), not 30 frames later when a corrupted
# pointer dispatches into garbage. Memory:
# feedback_zephyr_stack_sentinel_for_corruption_hunts.
CONFIG_STACK_SENTINEL=y
CONFIG_ASSERT=y

# PL011 console + LOG. Keep INF on the CDC class and the VC firmware
# driver so we see one line each at boot: "device 3 power -> ON",
# "board serial: ...", "CDC ACM device ready". Force UDC driver to
# WRN (its INF default fires "Prepare RX" several times per SETUP
# during enumeration -- not useful in steady state). Enable DBG
# locally if regressing the bring-up flow.
CONFIG_PRINTK=y
CONFIG_LOG=y
CONFIG_LOG_BUFFER_SIZE=8192
CONFIG_USBD_CDC_ACM_LOG_LEVEL_INF=y
CONFIG_BCM2835_FIRMWARE_LOG_LEVEL_INF=y
CONFIG_UDC_DRIVER_LOG_LEVEL_WRN=y
```

## app.overlay
```dts
/*
 * Phase 2.1 bring-up: enable the DWC2 USB controller as a device-mode
 * peripheral and declare a single CDC ACM UART child instance on it.
 *
 * The DWC2 node lives in bcm2710.dtsi (status="disabled" there); this
 * overlay flips it on for this sample only -- the board defconfig is
 * untouched, so the parallel wifi/SDIO work on the rpi-zero-2w-port
 * branch is not affected.
 *
 * Phase 2.4 (mailbox / VC power-domain): also enables &mailbox and
 * &firmware. The DWC2 vendor pre_enable hook issues SET_POWER_STATE
 * (USB_HCD, on) over the firmware property interface during USB init
 * to turn on the analog PHY power island that VC start.elf leaves
 * off. Without these two nodes enabled the USB controller is
 * digitally accessible but D+/D- aren't driven.
 */

&mailbox {
	status = "okay";
};

&firmware {
	status = "okay";
};

&usb {
	status = "okay";

	cdc_acm_uart0: cdc_acm_uart0 {
		compatible = "zephyr,cdc-acm-uart";
		label = "Zephyr USB CDC-ACM";
	};
};
```

## src/main.c
```c
/*
 * Copyright (c) 2026 jetpax
 *
 * SPDX-License-Identifier: Apache-2.0
 *
 * Phase 2.1 minimal CDC ACM bring-up for rpi_zero_2w.
 *
 * The USB stack initializes itself at SYS_INIT (we set
 * CONFIG_CDC_ACM_SERIAL_INITIALIZE_AT_BOOT=y) and the
 * `zephyr,cdc-acm-uart` DT node is bound by the class driver to look
 * like a regular UART. The app code is just a write loop: it pushes
 * a counted "hello USB" line every 500 ms via the standard UART
 * poll-out API. The CDC class translates that into bulk-IN packets
 * on the chip's endpoint 1 IN; the host PC sees them on its
 * /dev/cu.usbmodem* (macOS) / /dev/ttyACM0 (Linux) / COMn (Windows).
 *
 * We also LOG_INF every iteration so the PL011 console (1 Mbaud on
 * GPIO 14/15) gives us a side-channel view of device-side liveness
 * regardless of whether the host has the USB port open. This is the
 * key debugging feature for first bring-up: if the host never sees
 * /dev/cu.usbmodem* but the PL011 log keeps ticking, the device-side
 * stack is healthy and the failure is enumeration. If the PL011 log
 * itself stops at boot, we have an init-time wedge to investigate.
 */

#include <stdio.h>
#include <stdint.h>
#include <zephyr/device.h>
#include <zephyr/drivers/uart.h>
#include <zephyr/kernel.h>
#include <zephyr/sys/sys_io.h>
#include <zephyr/sys/device_mmio.h>
#include <zephyr/logging/log.h>

LOG_MODULE_REGISTER(usb_cdc_min, LOG_LEVEL_INF);

static const struct device *const cdc_dev =
	DEVICE_DT_GET_ONE(zephyr_cdc_acm_uart);

/* Bus-state probe — reads the DWC2 registers that tell us whether the
 * chip thinks a host is electrically attached. Useful when "/dev/cu.usbmodem*
 * never appears" so we can tell apart:
 *   - VBUS not sensed by the chip → no B-session valid → no pullup drive
 *   - VBUS sensed but pullup not on → soft-disconnect still asserted
 *   - Pullup on but host not enumerating → cable / port physical issue
 */
#define DWC2_PA       0x3F980000UL
#define DWC2_LEN      0x100UL

#define GOTGCTL       0x000
#define GAHBCFG       0x008
#define GUSBCFG       0x00C
#define GINTSTS       0x014
#define DCFG          0x800
#define DCTL          0x804
#define DSTS          0x808
#define PCGCCTL       0xE00

static void probe_bus_state(mm_reg_t base, const char *label)
{
	uint32_t gotgctl = sys_read32(base + GOTGCTL);
	uint32_t gintsts = sys_read32(base + GINTSTS);
	uint32_t dctl    = sys_read32(base + DCTL);
	uint32_t dsts    = sys_read32(base + DSTS);
	uint32_t dcfg    = sys_read32(base + DCFG);

	LOG_INF("--- bus probe (%s) ---", label);
	LOG_INF("GOTGCTL = 0x%08x  BvalidOvEn=%u BvalidOvVal=%u "
		"ConIDSts=%u BSesVld=%u",
		gotgctl,
		(gotgctl >> 6) & 1,   /* BvalidOvEn */
		(gotgctl >> 7) & 1,   /* BvalidOvVal */
		(gotgctl >> 16) & 1,  /* ConIDSts: 1=device, 0=host */
		(gotgctl >> 19) & 1); /* BSesVld */
	LOG_INF("GINTSTS = 0x%08x  CurMod=%u (1=host 0=device)",
		gintsts, gintsts & 1);
	LOG_INF("DCTL    = 0x%08x  SftDiscon=%u (want 0)",
		dctl, (dctl >> 1) & 1);
	LOG_INF("DSTS    = 0x%08x  EnumSpd=%u SuspSts=%u",
		dsts,
		(dsts >> 1) & 3,
		dsts & 1);
	LOG_INF("DCFG    = 0x%08x  DevAddr=%u",
		dcfg, (dcfg >> 4) & 0x7f);
	uint32_t pcgcctl = sys_read32(base + PCGCCTL);
	LOG_INF("PCGCCTL = 0x%08x  StopPClk=%u GateHclk=%u PwrClmp=%u "
		"RstPdwn=%u PhySleep=%u",
		pcgcctl,
		pcgcctl & 1,        /* StopPClk */
		(pcgcctl >> 1) & 1, /* GateHclk */
		(pcgcctl >> 2) & 1, /* PwrClmp */
		(pcgcctl >> 3) & 1, /* RstPdwnModule */
		(pcgcctl >> 6) & 1);/* PhySleep */
}

int main(void)
{
	mm_reg_t dwc2_base;

	if (!device_is_ready(cdc_dev)) {
		LOG_ERR("CDC ACM device not ready -- driver bind failed");
		return -1;
	}

	LOG_INF("CDC ACM device ready: %s", cdc_dev->name);

	device_map(&dwc2_base, DWC2_PA, DWC2_LEN, K_MEM_CACHE_NONE);

	/* Give init a moment to settle, then probe. */
	k_msleep(200);
	probe_bus_state(dwc2_base, "post-init (no host expected)");

	LOG_INF("");
	LOG_INF("** Unplug and replug the USB cable now -- bus probes will");
	LOG_INF("** be re-printed every 2 seconds. Look for changes in:");
	LOG_INF("**   BSesVld 0->1  = chip electrically detects host VBUS");
	LOG_INF("**   ConIDSts      = micro-USB OTG ID-pin state");
	LOG_INF("**   SftDiscon 0   = D+ pullup is being driven");
	LOG_INF("**   EnumSpd       = bus-detected speed (0=HS 1=FS 2=LS 3=FS)");
	LOG_INF("");

	unsigned int n = 0;

	while (1) {
		char buf[64];
		int len = snprintf(buf, sizeof(buf),
				   "hello USB #%u\r\n", n);

		for (int i = 0; i < len; i++) {
			uart_poll_out(cdc_dev, buf[i]);
		}

		if ((n % 4) == 0) {
			probe_bus_state(dwc2_base, "loop");
		}
		n++;
		k_msleep(500);
	}

	return 0;
}
```
