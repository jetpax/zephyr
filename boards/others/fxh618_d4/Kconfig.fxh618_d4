## boards/others/fxh618_d4/Kconfig.fxh618_d4
```kconfig
# Copyright (c) 2026 Jonathan E. Peace <jep@alphabetiq.com>
# SPDX-License-Identifier: Apache-2.0

config BOARD_FXH618_D4
	select SOC_SUN50I_H618
```

## boards/others/fxh618_d4/board.yml
```yaml
board:
  name: fxh618_d4
  full_name: FX-H618-D4 V10 TV Box
  vendor: others
  socs:
  - name: sun50i_h618
```

## boards/raspberrypi/rpi_zero_2w/Kconfig.rpi_zero_2w
```kconfig
# Copyright (c) 2026 jetpax
# SPDX-License-Identifier: Apache-2.0

config BOARD_RPI_ZERO_2W
	select SOC_BCM2710
```

## boards/sparkfun/thingplus_rp2350/Kconfig.sparkfun_thingplus_rp2350
```kconfig
# SPDX-License-Identifier: Apache-2.0

config BOARD_SPARKFUN_THINGPLUS_RP2350
	select SOC_RP2350A_M33 if BOARD_SPARKFUN_THINGPLUS_RP2350_RP2350A_M33 || \
				   BOARD_SPARKFUN_THINGPLUS_RP2350_RP2350A_M33_W
```

## boards/sparkfun/thingplus_rp2350/board.yml
```yaml
board:
  name: sparkfun_thingplus_rp2350
  full_name: SparkFun Thing Plus RP2350
  vendor: sparkfun
  socs:
  - name: rp2350a
    variants:
      - name: w
        cpucluster: m33
```

## drivers/clock_control/Kconfig.sunxi_h616
```kconfig
# Copyright (c) 2026 Jonathan E. Peace <jep@alphabetiq.com>
# SPDX-License-Identifier: Apache-2.0

config CLOCK_CONTROL_SUN50I_H616_CCU
	bool "Allwinner sun50i H616/H618 CCU driver"
	default y
	depends on DT_HAS_ALLWINNER_SUN50I_H616_CCU_ENABLED
	help
	  Clock control driver for the Allwinner H616/H618 clock control
	  unit, covering the SD/MMC and display-path clocks.
```

## drivers/display/Kconfig.bcm2835_fb
```kconfig
# Copyright (c) 2026 jetpax
# SPDX-License-Identifier: Apache-2.0

config BCM2835_FB
	bool "BCM2835/2710 VideoCore-firmware framebuffer (HDMI)"
	default y
	depends on DT_HAS_BRCM_BCM2835_FB_ENABLED
	select RASPBERRYPI_FIRMWARE
	help
	  Enable the VideoCore-firmware-backed HDMI framebuffer driver
	  for the BCM2835 / BCM2710 family. Requests a framebuffer from
	  the VC GPU via the property-tag mailbox interface and exposes
	  it through the Zephyr display driver API. Pixel format is
	  selectable per-instance via the `pixel-format` DT property --
	  PIXEL_FORMAT_ARGB_8888 (default) or PIXEL_FORMAT_RGB_565.

	  The HDMI scanout itself is brought up by the VideoCore boot
	  firmware according to config.txt; without `hdmi_force_hotplug=1`
	  the GPU only enables HDMI when a monitor is connected at power-on.
```

## drivers/display/Kconfig.sunxi_de33
```kconfig
# Copyright (c) 2026 Jonathan E. Peace <jep@alphabetiq.com>
# SPDX-License-Identifier: Apache-2.0

config DISPLAY_SUNXI_DE33
	bool "Allwinner H616/H618 DE33 + TCON-TV + DW-HDMI display"
	default y
	depends on DT_HAS_ALLWINNER_SUN50I_H616_DISPLAY_ENABLED
	select CLOCK_CONTROL
	select RESET
	help
	  Fixed-mode display pipeline driver for the Allwinner H616/H618:
	  DE33 mixer scanning out one XRGB8888 UI channel through
	  TCON-TV0 and the DesignWare HDMI controller.

config DISPLAY_SUNXI_DE33_DW_DUMP
	bool "Dump nonzero DW-HDMI core bytes after init"
	depends on DISPLAY_SUNXI_DE33
	help
	  Bring-up diagnostic: after the pipeline is up, print every
	  nonzero byte of the DW-HDMI core register file (0x0000-0x5100
	  and 0x7e00-0x7f00) over the console for a field diff against
	  the same dump taken on a known-good boot. Build with
	  CONFIG_LOG_PRINTK=n so the burst is not routed through the
	  deferred log buffer.

config DISPLAY_SUNXI_DE33_HW_SCALER
	bool "Scale the render surface with the channel's hardware scaler"
	depends on DISPLAY_SUNXI_DE33
	default y
	help
	  When render-width/render-height ask for a surface smaller than the
	  mode, drive the mixer channel's VI scaler (VSU) instead of expanding
	  every frame on the CPU. The scaler reads the small surface during
	  composition, so a frame costs a copy of the render surface rather
	  than of the whole screen. Coefficients are nearest-neighbour, so
	  output is identical to the software path. Say n to fall back to
	  CPU expansion.
```

## drivers/entropy/Kconfig.bcm2835
```kconfig
# Copyright (c) 2026 The Zephyr Project Contributors
# SPDX-License-Identifier: Apache-2.0

config ENTROPY_BRCM_BCM2835_RNG
	bool "Broadcom BCM2835 simple RNG driver"
	default y
	depends on DT_HAS_BRCM_BCM2835_RNG_ENABLED
	select ENTROPY_HAS_DRIVER
	help
	  Enable the Broadcom BCM2835 simple RNG block driver (used by
	  BCM2835/BCM2836/BCM2837/BCM2710 — Raspberry Pi 1/2/3/Zero family).
	  Note this is distinct from the iProc RNG200 on BCM2711 (Pi 4).
```

## drivers/firmware/bcm2835/Kconfig
```kconfig
# Copyright (c) 2026 jetpax
# SPDX-License-Identifier: Apache-2.0

config BCM2835_MBOX
	bool "Broadcom BCM2835 ARM <-> VideoCore mailbox"
	default y
	depends on DT_HAS_BRCM_BCM2835_MBOX_ENABLED
	help
	  Polled transport for the BCM2835-family mailbox (single
	  hardware FIFO pair, 16 channels multiplexed in the low 4 bits
	  of each message word). Required by CONFIG_BCM2835_FIRMWARE.

if BCM2835_MBOX

config BCM2835_MBOX_INIT_PRIORITY
	int "BCM2835 mailbox driver init priority"
	default 30
	help
	  POST_KERNEL init priority. Must run before any consumer
	  (firmware property driver, currently 35; USB CDC ACM via
	  vendor pre_enable hook, default 99).

module = BCM2835_MBOX
module-str = bcm2835_mbox
source "subsys/logging/Kconfig.template.log_config"

endif # BCM2835_MBOX

config BCM2835_FIRMWARE
	bool "Raspberry Pi VideoCore firmware property-tag interface"
	default y
	depends on DT_HAS_BRCM_BCM2835_FIRMWARE_ENABLED
	depends on BCM2835_MBOX
	select CACHE_MANAGEMENT
	help
	  VideoCore firmware RPC over channel 8 of the BCM2835 mailbox.
	  Exposes helpers like bcm2835_property_set_power_state() for
	  SoC power-domain control, used during USB / SDIO / I2C
	  bring-up to turn on peripheral power islands the VC start.elf
	  leaves off.

	  Selects CACHE_MANAGEMENT because the request buffer is shared
	  with VC firmware and needs explicit flush / invalidate around
	  each call (see feedback memory
	  feedback_zephyr_sys_cache_needs_cache_management).

if BCM2835_FIRMWARE

module = BCM2835_FIRMWARE
module-str = bcm2835_firmware
source "subsys/logging/Kconfig.template.log_config"

endif # BCM2835_FIRMWARE
```

## drivers/hwinfo/Kconfig.bcm2835
```kconfig
# Copyright (c) 2026 jetpax
# SPDX-License-Identifier: Apache-2.0

config HWINFO_BCM2835
	bool "BCM283x device ID via VideoCore firmware"
	default y
	depends on SOC_BCM2710
	depends on BCM2835_FIRMWARE
	select HWINFO_HAS_DRIVER
	help
	  Implement hwinfo_get_device_id() by issuing the GET_BOARD_SERIAL
	  property tag (0x00010004) to the VideoCore firmware. Returns
	  the 8-byte OTP serial number every Pi has burned in at factory.
	  Used by the USB device stack to fill the iSerialNumber string
	  descriptor, by MCUboot for device-unique entropy, etc.

	  Pulls in CONFIG_BCM2835_FIRMWARE (and therefore CONFIG_BCM2835_MBOX
	  and CONFIG_CACHE_MANAGEMENT) as dependencies.
```

## drivers/i2c/Kconfig.bcm2835
```kconfig
# Broadcom BCM2835 BSC (I2C) controller
#
# Copyright (c) 2026 Jonathan Elliot Peace <jep@alphabetiq.com>
# SPDX-License-Identifier: Apache-2.0

config I2C_BCM2835
	bool "Broadcom BCM2835 BSC (I2C) master driver"
	default y
	depends on DT_HAS_BRCM_BCM2835_I2C_ENABLED
	select PINCTRL
	select I2C_TRANSFER_TIMEOUT_SUPPORTED
	help
	  Enable the interrupt-driven master driver for the BCM2835 /
	  BCM2710 / BCM2837 BSC ("Broadcom Serial Controller") I2C
	  controller -- the BSC0/BSC1/BSC2 instances on the Raspberry Pi
	  family. 7-bit addressing only; multi-message transfers may have
	  at most one read, which must be the last message.
```

## drivers/i2s/Kconfig.bcm2835
```kconfig
# Broadcom BCM2835 I2S / PCM controller
#
# Copyright (c) 2026 jetpax
# SPDX-License-Identifier: Apache-2.0

config I2S_BCM2835
	bool "Broadcom BCM2835 I2S / PCM controller driver"
	default y
	depends on DT_HAS_BRCM_BCM2835_I2S_ENABLED
	select DMA
	help
	  Enable the driver for the BCM2835 / BCM2710 / BCM2837 PCM / I2S
	  controller -- the audio interface on the Raspberry Pi 40-pin
	  header. Master mode, I2S (Philips) format, 16-bit stereo;
	  sample buffers are streamed through the BCM2835 DMA controller,
	  paced by the PCM TX/RX DREQ lines.

if I2S_BCM2835

config I2S_BCM2835_TX_BLOCK_COUNT
	int "TX queue length"
	default 4
	help
	  Maximum number of TX buffers that can be queued for
	  transmission at once.

config I2S_BCM2835_RX_BLOCK_COUNT
	int "RX queue length"
	default 4
	help
	  Maximum number of RX buffers the driver can hold before the
	  application reads them.

endif # I2S_BCM2835
```

## drivers/misc/bcm2835_v3d/Kconfig
```kconfig
# Copyright (c) 2026 jetpax
# SPDX-License-Identifier: Apache-2.0

config BCM2835_V3D
	bool "Broadcom VideoCore IV 3D (QPU) compute driver"
	default y
	depends on DT_HAS_BRCM_BCM2835_V3D_ENABLED
	depends on RASPBERRYPI_FIRMWARE
	select MMU
	help
	  Direct V3D scheduler-queue (SRQ) driver for the BCM2835 /
	  BCM2710 / BCM2711 QPUs. Lets ARM launch hand-written QPU
	  kernels (qasm assembled to uint32_t[]) without going through
	  the firmware mailbox tag 0x60010 (which adds ~1 ms per kick).

	  Coherent memory for kernel code + uniforms comes from the
	  firmware mailbox ALLOCATE/LOCK property tags, which the
	  rpi_fw driver already implements.

if BCM2835_V3D

config BCM2835_V3D_INIT_PRIORITY
	int "init priority"
	default 70
	help
	  Driver init priority within POST_KERNEL. Must be strictly
	  greater than CONFIG_RASPBERRYPI_FIRMWARE_INIT_PRIORITY (the
	  V3D driver depends on the firmware mailbox for QPU enable and
	  coherent memory allocation).

config BCM2835_V3D_LOG_LEVEL
	int "log level"
	range 0 4
	default 3
	help
	  Log level for the bcm2835_v3d driver (0 = off, 4 = debug).

endif # BCM2835_V3D
```

## drivers/mspi/Kconfig.rpi_pico
```kconfig
# Copyright (c) 2026 SS/pyDirect contributors
# SPDX-License-Identifier: Apache-2.0

config MSPI_RPI_PICO
	bool "Raspberry Pi RP2350 QMI MSPI controller driver"
	default y
	depends on DT_HAS_RASPBERRYPI_PICO_QMI_ENABLED
	select PINCTRL
	select MSPI_XIP
	help
	  Drives the RP2350 QSPI Memory Interface (QMI) as an MSPI bus.
	  Exposes CS1 only — CS0/m[0] is owned by the existing
	  raspberrypi,pico-flash-controller binding on the same hardware
	  peripheral. Intended for boards that wire APS6404L pSRAM (or
	  similar) on the second chip-select.
```

## drivers/pwm/Kconfig.bcm2835
```kconfig
# Broadcom BCM2835 PWM controller
#
# Copyright (c) 2026 Jonathan Elliot Peace <jep@alphabetiq.com>
# SPDX-License-Identifier: Apache-2.0

config PWM_BCM2835
	bool "Broadcom BCM2835 PWM driver"
	default y
	depends on DT_HAS_BRCM_BCM2835_PWM_ENABLED
	select PINCTRL
	help
	  Enable the driver for the BCM2835 / BCM2710 / BCM2837 PWM
	  controller on the Raspberry Pi family -- one block with two
	  output channels, run in mark:space mode. The driver programs
	  the CM_PWM clock-manager slice directly (19.2 MHz oscillator
	  source, integer divisor).
```

## drivers/reset/Kconfig.sunxi_h616
```kconfig
# Copyright (c) 2026 Jonathan E. Peace <jep@alphabetiq.com>
# SPDX-License-Identifier: Apache-2.0

config RESET_SUN50I_H616_CCU
	bool "Allwinner sun50i H616/H618 CCU reset driver"
	default y
	depends on DT_HAS_ALLWINNER_SUN50I_H616_CCU_RESET_ENABLED
	help
	  Reset controller driver for the block reset lines in the
	  Allwinner H616/H618 clock control unit.
```

## drivers/sdhc/Kconfig.bcm2835_sdhost
```kconfig
# Copyright (c) 2026 jetpax
# SPDX-License-Identifier: Apache-2.0

config BCM2835_SDHOST
	bool "BCM2835 / BCM2710 / BCM2837 legacy SDHost host controller"
	default y
	depends on DT_HAS_BRCM_BCM2835_SDHOST_ENABLED
	select SDHC_SUPPORTS_NATIVE_MODE
	help
	  Enable the Broadcom BCM2835-family legacy SDHost host controller
	  driver. Drives the external microSD card slot on Pi 3 / Pi Zero
	  2 W via GPIO 48..53 at ALT0. Polled implementation of the sdhc.h
	  device API; no IRQ support yet, no DMA yet -- the BCM SDHost
	  block's small FIFO is drained by the CPU.

if BCM2835_SDHOST

config SDHC_BCM2835_SDHOST_SELFTEST
	bool "Run a card-init self-test in driver init"
	default n
	help
	  After the driver has reset the controller and configured the bus
	  to 400 kHz / 1-bit / 3.3 V, fire CMD0..CMD9 through the driver's
	  own request() path to verify card identification end-to-end
	  before the SD subsystem mounts the disk. Logs each step; does not
	  fail init on command errors (the device stays available for later
	  layers). Used during bring-up; disable in production builds.

endif # BCM2835_SDHOST
```

## drivers/sdhc/Kconfig.sunxi_smhc
```kconfig
# Copyright (c) 2026 Jonathan E. Peace <jep@alphabetiq.com>
# SPDX-License-Identifier: Apache-2.0

config SDHC_SUNXI_SMHC
	bool "Allwinner sunxi SMHC host controller"
	default y
	depends on DT_HAS_ALLWINNER_SUNXI_SMHC_ENABLED
	select SDHC_SUPPORTS_NATIVE_MODE
	select CLOCK_CONTROL
	select RESET
	help
	  Enable the Allwinner SMHC SD/MMC host controller driver
	  (H6-generation IP: H616/H618). Polled PIO implementation of
	  the sdhc.h device API; module clock from OSC24M, no IRQ, no
	  DMA yet.
```

## drivers/sensor/broadcom/bcm2835_vc_thermal/Kconfig
```kconfig
# Copyright (c) 2026 jetpax
# SPDX-License-Identifier: Apache-2.0

config BCM2835_VC_THERMAL
	bool "Raspberry Pi BCM2835 VideoCore SoC temperature sensor"
	default y
	depends on DT_HAS_RASPBERRYPI_BCM2835_VC_THERMAL_ENABLED
	depends on BCM2835_FIRMWARE
	help
	  Enable the Raspberry Pi BCM2835/2710 SoC temperature sensor.
	  The SoC die temperature is read through the VideoCore firmware
	  GET_TEMPERATURE property tag (the source behind
	  `vcgencmd measure_temp`) and exposed as SENSOR_CHAN_DIE_TEMP.
```

## drivers/timer/Kconfig.bcm2835
```kconfig
# Copyright (c) 2026 Jonathan Elliot Peace <jep@alphabetiq.com>
# SPDX-License-Identifier: Apache-2.0

config BCM2835_SYSTEM_TIMER
	bool "BCM2835 system timer"
	default y
	depends on DT_HAS_BRCM_BCM2835_SYSTEM_TIMER_ENABLED
	help
	  Kernel system-clock driver for the Broadcom BCM2835 free-running
	  1 MHz system timer (Raspberry Pi 1 / Zero / Zero W). A compare-channel
	  match interrupt drives a periodic (non-tickless) kernel tick.
```
