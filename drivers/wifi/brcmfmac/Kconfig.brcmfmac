## drivers/wifi/brcmfmac/Kconfig.brcmfmac
```kconfig
# Copyright (c) 2026 Jonathan Elliot Peace <jep@alphabetiq.com>
# SPDX-License-Identifier: Apache-2.0

menuconfig WIFI_BRCMFMAC
	bool "Broadcom BCM43xxx SDIO Wi-Fi (brcmfmac)"
	depends on DT_HAS_BRCM_BCM43XXX_SDIO_ENABLED
	default y
	select WIFI_OFFLOAD
	select WIFI_USE_NATIVE_NETWORKING
	select NET_L2_ETHERNET
	select NET_L2_WIFI_MGMT
	select SDHC
	select SDIO_STACK
	select GPIO
	help
	  Native-L2 driver for SDIO-attached Broadcom/Cypress combo chips
	  speaking the brcmfmac SDPCM+BCDC protocol. The chip handles
	  802.11; Zephyr's ethernet/IP stack runs on top. Firmware and
	  per-board NVRAM are supplied by the hal_broadcom module via
	  `west blobs fetch hal_broadcom`.

	  When using samples/net/wifi/shell, raise
	  CONFIG_NET_MGMT_EVENT_STACK_SIZE to 4096 -- the 768-byte default
	  overflows on scan-result formatting (each AP raises a net_mgmt
	  event whose handler prints a row).

if WIFI_BRCMFMAC

config WIFI_BRCMFMAC_FIRMWARE_FILE
	string "Firmware file name (under hal_broadcom blobs)"
	default "brcmfmac43436s-sdio.bin"
	help
	  Name of the brcmfmac firmware blob under
	  ${ZEPHYR_HAL_BROADCOM_MODULE_DIR}/zephyr/blobs/img/brcmfmac/.
	  Set by the board defconfig to match the on-board chip.

config WIFI_BRCMFMAC_NVRAM_FILE
	string "NVRAM file name (under hal_broadcom blobs)"
	default "brcmfmac43436s-sdio.txt"
	help
	  Name of the brcmfmac per-board NVRAM blob under
	  ${ZEPHYR_HAL_BROADCOM_MODULE_DIR}/zephyr/blobs/img/brcmfmac/.
	  Encodes board-specific antenna, calibration and PA settings.

config WIFI_BRCMFMAC_CLM_FILE
	string "CLM blob file name (under hal_broadcom blobs, empty = none)"
	default ""
	help
	  Name of the CLM (regulatory/channel database) blob under
	  ${ZEPHYR_HAL_BROADCOM_MODULE_DIR}/zephyr/blobs/img/brcmfmac/.
	  Cypress trim-on-build (TOB) firmware images ship with the CLM
	  stripped out and refuse to enable the radio until one is
	  downloaded via the "clmload" iovar (country reads back as the
	  null code "#n", WLC_UP reports OK but isup stays 0, and radio
	  ops fail BCME_NOTUP). Firmware with a built-in CLM (e.g. the
	  43436s image) does not need this; leave empty to skip the
	  download.

config WIFI_BRCMFMAC_COUNTRY
	string "Regulatory country code (ISO3166 alpha2, empty = CLM default)"
	default ""
	help
	  Country code pushed to the firmware after WLC_UP via the
	  "country" iovar (sent as alpha2 with rev=0, matching Linux's
	  handling for chips on the ISO3166 fallback list). Leave empty
	  to keep the firmware/CLM default domain. The code must exist
	  in the firmware's CLM or the set is rejected and the default
	  is kept.

config WIFI_BRCMFMAC_RX_THREAD_STACK_SIZE
	int "RX thread stack size"
	default 4096
	help
	  Stack for the dedicated RX polling thread that drains F2 and
	  dispatches frames by SDPCM channel.

config WIFI_BRCMFMAC_RX_THREAD_PRIO
	int "RX thread priority"
	default 4

endif # WIFI_BRCMFMAC
```

## dts/bindings/clock/allwinner,sun50i-h616-ccu.yaml
```yaml
# Copyright (c) 2026 Jonathan E. Peace <jep@alphabetiq.com>
# SPDX-License-Identifier: Apache-2.0

description: |
  Allwinner H616/H618 clock control unit (CCU).

  Clock consumers reference clocks by the identifiers in
  include/zephyr/dt-bindings/clock/sun50i-h616-ccu.h, which mirror the
  Linux binding.

compatible: "allwinner,sun50i-h616-ccu"

include: [clock-controller.yaml, base.yaml]

properties:
  reg:
    required: true

  "#clock-cells":
    const: 1

clock-cells:
  - id
```

## dts/bindings/clock/allwinner,sun50i-h618-ccu.yaml
```yaml
# Copyright (c) 2026 Jonathan E. Peace <jep@alphabetiq.com>
# SPDX-License-Identifier: Apache-2.0

description: |
  Allwinner H618 CCU. The H618 unit is the H616 one; see
  allwinner,sun50i-h616-ccu.yaml.

compatible: "allwinner,sun50i-h618-ccu"

include: allwinner,sun50i-h616-ccu.yaml
```

## dts/bindings/display/allwinner,sun50i-h616-display.yaml
```yaml
# Copyright (c) 2026 Jonathan E. Peace <jep@alphabetiq.com>
# SPDX-License-Identifier: Apache-2.0

description: |
  Allwinner H616/H618 display pipeline: DE33 mixer -> TCON-TV0 ->
  DesignWare HDMI TX + Allwinner PHY, fixed video mode.

  One node covers the whole path (the vendor DT shape): reg entries
  name the DE block, TCON-TOP, TCON-TV0, the DW-HDMI core and the PHY
  wrapper. Clock and reset names follow the roles in the recipes doc,
  with the H6 convention for the two HDMI resets (ctrl = RST_BUS_HDMI_SUB,
  phy = RST_BUS_HDMI).

compatible: "allwinner,sun50i-h616-display"

include: [base.yaml, reset-device.yaml]

properties:
  reg:
    required: true

  reg-names:
    required: true
    description: Must be "de", "tcon_top", "tcon_tv", "hdmi", "hdmi_phy".

  clocks:
    required: true

  clock-names:
    required: true
    description: |
      Must be "bus_de", "de", "bus_tcon_top", "bus_tcon_tv", "tcon_tv",
      "bus_hdmi", "hdmi", "hdmi_slow".

  resets:
    required: true

  reset-names:
    required: true
    description: Must be "de", "tcon_top", "tcon_tv", "hdmi_ctrl", "hdmi_phy".

  mode:
    type: string
    default: "1080p60"
    enum:
      - "1080p60"
      - "720p60"
      - "576p50"
    description: Fixed output mode; picked by what the monitor accepts.

  tcon-test-pattern:
    type: boolean
    description: |
      Bring-up bisect. Drive TCON-TV from its internal colorbar
      generator instead of the DE33 mixer; proves TCON + tcon-top +
      HDMI + PHY + clocks without trusting the DE path.
```

## dts/bindings/display/brcm,bcm2835-fb.yaml
```yaml
# Copyright (c) 2026 jetpax
# SPDX-License-Identifier: Apache-2.0

description: |
  Raspberry Pi BCM2835/2710 VideoCore-firmware framebuffer.

  On the Pi, the VideoCore GPU owns HDMI output -- the GPU drives the
  PHY (configured via config.txt at boot), the HVS, and the scanout.
  The ARM side asks the GPU for a framebuffer via the property-tag
  mailbox interface and writes pixels into the returned memory.

  Modelled as a child of the VideoCore firmware node (the parent does
  not own any MMIO of its own; the framebuffer lives in VC-managed
  shared DRAM whose address is only known at runtime).

  When `width` and `height` are zero (or omitted), the driver reads
  VC's current scanout dimensions -- the resolution VC negotiated
  with the monitor's EDID at boot -- and asks for a framebuffer of
  that size. This is the typical setup for HDMI, where the native
  resolution depends on the attached monitor.

  Exposes the Zephyr display driver API at PIXEL_FORMAT_ARGB_8888 (depth
  32) or PIXEL_FORMAT_RGB_565 (depth 16). The format is fixed at boot
  by the `pixel-format` property and reported back via
  display_get_capabilities(); set_pixel_format() only accepts a no-op
  set to the configured format (VC pins depth at allocate time).

compatible: "brcm,bcm2835-fb"

include: base.yaml

properties:
  width:
    type: int
    default: 0
    description: |
      Framebuffer width in pixels. 0 (default) means "auto-detect
      from VC's current display configuration" -- typically the
      monitor's preferred native mode.

  height:
    type: int
    default: 0
    description: |
      Framebuffer height in pixels. 0 (default) means "auto-detect"
      (see `width`).

  pixel-format:
    type: int
    default: 0x8  # PANEL_PIXEL_FORMAT_ARGB_8888
    description: |
      Framebuffer pixel format. One of the PANEL_PIXEL_FORMAT_*
      constants from <zephyr/dt-bindings/display/panel.h>. Supported
      values are PANEL_PIXEL_FORMAT_ARGB_8888 (default, depth 32) and
      PANEL_PIXEL_FORMAT_RGB_565 (depth 16). 16 bpp halves the per-frame
      write bandwidth into VideoCore-shared DRAM and is the natural
      target for small embedded software renderers that emit RGB565.

  render-width:
    type: int
    default: 0
    description: |
      Optional virtual (framebuffer) width in pixels. 0 (default)
      means "render at the same resolution as the physical scanout"
      -- no scaling. When non-zero and smaller than `width`, the
      VideoCore HVS hardware scaler upscales the framebuffer to the
      scanout resolution on the fly: the CPU paints a smaller buffer
      while the monitor still receives full-resolution video. Pair
      with `render-height` -- both must be set.

  render-height:
    type: int
    default: 0
    description: |
      Optional virtual (framebuffer) height in pixels. See
      `render-width`.
```

## dts/bindings/firmware/brcm,bcm2835-firmware.yaml
```yaml
# Copyright (c) 2026 jetpax
# SPDX-License-Identifier: Apache-2.0

description: |
  Raspberry Pi VideoCore firmware property-tag interface.

  Sits on top of the BCM2835 mailbox (channel 8, MBOX_CHAN_PROPERTY).
  Exposes the SoC-config RPC surface: power-domain on/off, clock
  rate get/set, board revision, MAC address, temperature, etc.

  Bound to its mailbox controller via the standard `mboxes` property;
  the Zephyr Pi mailbox binding uses no cell data (channel is fixed
  at 8 inside the firmware driver, since the property-tag protocol
  is a single-channel thing).

  Matches Linux's drivers/firmware/raspberrypi.c.

compatible: "brcm,bcm2835-firmware"

include: [base.yaml]

properties:
  mboxes:
    required: true
    description: |
      Reference to the BCM2835 mailbox controller. Cell count = 0
      (mailbox node must declare `#mbox-cells = <0>`) — the
      property-tag protocol is channel-fixed at 8 inside this driver,
      so no per-consumer channel cell is needed.
```

## dts/bindings/i2s/brcm,bcm2835-i2s.yaml
```yaml
# Copyright (c) 2026 jetpax
# SPDX-License-Identifier: Apache-2.0

description: |
  Broadcom BCM2835 / BCM2710 / BCM2837 PCM / I2S controller.

  This is the PCM audio interface Linux binds with "brcm,bcm2835-i2s" --
  the I2S block exposed on the Raspberry Pi 40-pin header (GPIO 18..21,
  ALT0). It is a DMA-paced controller: sample buffers are streamed
  between memory and its TX/RX FIFOs through the BCM2835 DMA controller,
  with the PCM TX/RX DREQ lines pacing the transfers.

  In master (controller) mode the bit clock is derived from the SoC
  clock manager's PCM clock, a separate register block; the driver
  programs that divider directly at i2s_configure() time, so there is
  no clocks phandle here.

compatible: "brcm,bcm2835-i2s"

include: [i2s-controller.yaml, pinctrl-device.yaml]

properties:
  reg:
    required: true

  interrupts:
    required: true

  # pinctrl-0 / pinctrl-names come from the pinctrl-device.yaml include
  # and are intentionally NOT required: a board may mux GPIO 18..21 to
  # ALT0 via pinctrl at init, or leave them unset and mux imperatively
  # at runtime. See /private/tmp/zephyr_board_config.html.

  dmas:
    required: true
    description: |
      TX and RX DMA channel specifiers. The single dma-cell is the
      peripheral DREQ number used to pace the transfer: 2 for PCM TX,
      3 for PCM RX.

  dma-names:
    required: true
    description: Must be "tx" and "rx".
```

## dts/bindings/interrupt-controller/brcm,bcm2835-armctrl-ic.yaml
```yaml
# Copyright (c) 2026 Jonathan Elliot Peace <jep@alphabetiq.com>
# SPDX-License-Identifier: Apache-2.0

description: |
  BCM2835 ARMC peripheral interrupt controller -- the "GPU IRQ" side
  of the BCM283x family (Pi 1 / Pi 2 / Pi 3 / Pi Zero family).

  Hangs off the BCM2836 ARM-local intc as a child. Aggregates 64 GPU
  IRQs (PEND1 + PEND2 banks) plus 8 ARMC "basic" IRQs into the GPU
  cascade line of its parent.

  Zephyr exposes a flat 0..71 IRQ space:
    0..7   = basic bank
    8..39  = GPU PEND1 (bits 0..31)
    40..71 = GPU PEND2 (bits 0..31)
  (See <zephyr/dt-bindings/interrupt-controller/bcm2835-armctrl.h>.)

compatible: "brcm,bcm2835-armctrl-ic"

include: [interrupt-controller.yaml, base.yaml]

properties:
  reg:
    required: true

  interrupts:
    description: |
      The single GPU-cascade IRQ on the parent BCM2836 ARM-local intc.
      Present only when this controller is cascaded (BCM2836 / Pi 2+).
      On the BCM2835 (Pi 1 / Zero / Zero W) the ARMC is the root
      interrupt controller, wired directly to the ARM core IRQ line, so
      it has no parent interrupt and this property is omitted.

  interrupt-controller:
    required: true

  "#interrupt-cells":
    const: 3
    description: |
      Cell 0: flat IRQ number (0..71).
      Cell 1: trigger-type flags (IRQ_TYPE_LEVEL / IRQ_TYPE_EDGE).
      Cell 2: priority -- unused by this controller, kept as a
              fixed third cell for parity with the parent
              brcm,bcm2836-l1-intc binding (see its rationale).

interrupt-cells:
  - irq
  - flags
  - priority
```

## dts/bindings/misc/brcm,bcm2835-v3d.yaml
```yaml
# Copyright (c) 2026 jetpax
# SPDX-License-Identifier: Apache-2.0

description: |
  Broadcom VideoCore IV 3D (V3D) hardware -- the 12-QPU SIMD compute
  engine on BCM2835 / BCM2710 / BCM2711 SoCs. Each QPU is a 16-lane
  32-bit SIMD core; the V3D scheduler-request queue (SRQ) registers
  let ARM launch hand-written QPU kernels (qasm assembled to
  uint32_t[]) and wait for their completion.

  Code, per-QPU uniforms, and any I/O buffers live in firmware-
  allocated GPU-coherent memory (mailbox ALLOCATE_MEMORY +
  LOCK_MEMORY property tags). The driver holds a phandle to the
  firmware mailbox device for those allocations.

  The QPU clock domain must be powered on at boot via the
  SET_ENABLE_QPU mailbox tag before any SRQ-queue access. The
  driver handles this during initialisation.

compatible: "brcm,bcm2835-v3d"

include: base.yaml

properties:
  reg:
    required: true
    description: |
      Base address and size of the V3D register window. 4 KiB is
      sufficient -- the SRQ + cache-control registers used by the
      driver live below 0x440.

  firmware:
    type: phandle
    required: true
    description: |
      Phandle to the VideoCore firmware mailbox device. Used for QPU
      enable (SET_ENABLE_QPU) and for allocating GPU-coherent memory
      that holds QPU code + uniforms + I/O buffers.
```

## dts/bindings/mspi/raspberrypi,pico-qmi.yaml
```yaml
# Copyright (c) 2026 SS/pyDirect contributors
# SPDX-License-Identifier: Apache-2.0

description: |
  Raspberry Pi RP2350 QSPI Memory Interface (QMI) exposed as an MSPI
  controller. Drives the second chip-select (CS1) only — CS0 is owned by
  the existing flash-controller binding (raspberrypi,pico-flash-controller)
  on the same hardware peripheral.

  This binding is intended to be applied as a sibling node in a board
  overlay; the controller driver uses the qmi_hw register window from the
  pico-sdk HAL and does not consume the DT reg property.

compatible: "raspberrypi,pico-qmi"

include: [pinctrl-device.yaml, mspi-controller.yaml]

properties:
  pinctrl-0:
    required: true

  pinctrl-names:
    required: true
```
