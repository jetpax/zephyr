## dts/bindings/pinctrl/brcm,bcm2711-pinctrl.yaml
```yaml
# Copyright (c) 2025 Muhammad Waleed Badar
# SPDX-License-Identifier: Apache-2.0

description: Broadcom BCM2711 pin controller

compatible: "brcm,bcm2711-pinctrl"

include: base.yaml

properties:
  reg:
    required: true

  legacy-pull-control:
    type: boolean
    description: |
      The pull-control register layout differs across the BCM283x family:

        - BCM2711 (Pi 4): GPIO_PUP_PDN_CNTRL_REG at offset 0xE4. Modern
          single-write; this is the binding's default.
        - BCM2835 / BCM2836 / BCM2837 / BCM2710 (Pi 1..3, Pi Zero, Pi
          Zero 2 W): legacy GPPUD / GPPUDCLK0 / GPPUDCLK1 sequence at
          offsets 0x94 / 0x98 / 0x9C; offset 0xE4 is reserved.

      Set this property on nodes that target BCM2710 / BCM2835-family
      silicon. The peripheral compatible (brcm,bcm2711-pinctrl) is shared
      because every other register in the controller behaves the same;
      only the pull-control sequence differs.

child-binding:
  description: |
    Pin configuration state nodes.

  child-binding:
    description: |
      Pin configuration group.

      Each group within a pin configuration state contains pins that share
      the same bias (pull-up/pull-down) configuration.

    include:
      - name: pincfg-node.yaml
        property-allowlist:
          - bias-disable
          - bias-pull-down
          - bias-pull-up

    properties:
      pinmux:
        type: array
        required: true
        description: |
          An array of pins for this group. Each element is encoded as:
          - Bits 0-7: Pin number (0-57)
          - Bits 8-10: Function select (0-7)

          Use BCM2711_PINMUX(pin, func) to construct values.
```

## dts/bindings/pwm/brcm,bcm2835-pwm.yaml
```yaml
# Copyright (c) 2026 Jonathan Elliot Peace <jep@alphabetiq.com>
# SPDX-License-Identifier: Apache-2.0

description: |
  Broadcom BCM2835 / BCM2710 / BCM2837 PWM controller.

  Same silicon block Linux binds with "brcm,bcm2835-pwm" -- one PWM
  block with two output channels sharing a reference clock. The
  driver runs the block in mark:space mode; the serialiser / FIFO
  (audio) mode is out of scope.

  Two register windows: the PWM block itself and the CM_PWM slice of
  the clock manager (CM_PWMCTL / CM_PWMDIV), which the driver
  programs directly -- 19.2 MHz crystal oscillator source divided by
  an integer divisor chosen from clock-frequency. Direct programming
  mirrors the vendor driver; moving it behind a Zephyr clock-control
  provider is a possible follow-up.

  Channel 0 is the datasheet's PWM0 (RNG1/DAT1, GPIO 12 ALT0 or
  GPIO 18 ALT5), channel 1 is PWM1 (RNG2/DAT2, GPIO 13 ALT0 or
  GPIO 19 ALT5). GPIO 40/41/45 also reach the block but carry the
  analog audio path on Pi boards and are not on the 40-pin header.

compatible: "brcm,bcm2835-pwm"

include: [pwm-controller.yaml, pinctrl-device.yaml, base.yaml]

properties:
  reg:
    required: true

  reg-names:
    required: true
    description: |
      Must be "pwm" (the PWM block) and "cm" (the two-register
      CM_PWM clock-manager slice), in that order.

  clock-frequency:
    type: int
    required: true
    description: |
      Requested reference-clock (counter tick) rate in Hz. The
      driver rounds it to the nearest integer division of the
      oscillator; the resulting divisor must land in 2..4095. Period
      and pulse handed to pwm_set_cycles() are in ticks of this
      clock, and pwm_get_cycles_per_sec() reports the actual rate
      after rounding.

  oscillator-frequency:
    type: int
    default: 19200000
    description: |
      Crystal oscillator rate in Hz feeding the CM_PWM divider.
      19.2 MHz on every BCM2835/2710/2837 board; the property exists
      for family members with a different crystal.

  "#pwm-cells":
    const: 3

pwm-cells:
  - channel
  - period
  - flags

# pinctrl-0 / pinctrl-names come from pinctrl-device.yaml. They are
# intentionally not required here -- a board may route PWM to pins
# via pinctrl at init, or omit pinctrl-0 and mux imperatively at
# runtime. See the layered board-config notes alongside the SPI and
# SDHost bindings.
```

## dts/bindings/reset/allwinner,sun50i-h616-ccu-reset.yaml
```yaml
# Copyright (c) 2026 Jonathan E. Peace <jep@alphabetiq.com>
# SPDX-License-Identifier: Apache-2.0

description: |
  Reset lines of the Allwinner H616/H618 CCU. Child node of the CCU;
  the register block is the parent's. Line identifiers live in
  include/zephyr/dt-bindings/reset/sun50i-h616-ccu.h and mirror the
  Linux binding.

compatible: "allwinner,sun50i-h616-ccu-reset"

include: [reset-controller.yaml, base.yaml]

properties:
  "#reset-cells":
    const: 1

reset-cells:
  - id
```

## dts/bindings/rng/brcm,bcm2835-rng.yaml
```yaml
# Copyright (c) 2026 The Zephyr Project Contributors
# SPDX-License-Identifier: Apache-2.0

description: |
  Broadcom BCM2835 simple hardware RNG block.

  Present on BCM2835/BCM2836/BCM2837/BCM2710 SoCs (Raspberry Pi 1/2/3/Zero
  family). Distinct from the iProc RNG200 on BCM2711 (Pi 4), which uses
  the "brcm,iproc-rng200" / "brcm,bcm2711-rng200" compatibles.

compatible: "brcm,bcm2835-rng"

include: base.yaml

properties:
  reg:
    required: true
```

## dts/bindings/sdhc/allwinner,sunxi-smhc.yaml
```yaml
# Copyright (c) 2026 Jonathan E. Peace <jep@alphabetiq.com>
# SPDX-License-Identifier: Apache-2.0

description: |
  Allwinner SMHC SD/MMC host controller (sunxi), driven in PIO mode.

  Covers the H6-generation IP (H616/H618: new timing mode, THLDC at
  0x100, FIFO at 0x200). Clocking comes from the SoC CCU: the "ahb"
  clock is the bus gate, the "mod" clock is the module clock whose
  rate the driver programs, and the reset line is the block's BGR
  reset.

compatible: "allwinner,sunxi-smhc"

include: [sdhc.yaml, base.yaml, reset-device.yaml]

properties:
  reg:
    required: true

  interrupts:
    required: true

  clocks:
    required: true

  clock-names:
    required: true
    description: Must be "ahb" then "mod".

  resets:
    required: true

  allwinner,pio-bank-reg:
    type: int
    description: |
      PIO bank register base holding the card pins. When present the
      driver muxes pins 0..5 of that bank to function 2 (mmc), with
      pull-up and drive level 2. The BROM leaves this set after SD
      boot; setting it here removes the dependence on boot path.
```

## dts/bindings/sdhc/brcm,bcm2835-sdhci.yaml
```yaml
# Copyright (c) 2026 jetpax
# SPDX-License-Identifier: Apache-2.0

description: |
  Broadcom BCM2835 / BCM2710 / BCM2837 Arasan SD3.0 host controller
  (EMMC). Standard SDHCI register layout but with two silicon quirks
  worth knowing about:

    - all register accesses must be 32-bit aligned 32-bit wide;
      the driver synthesises 8/16-bit accesses via RMW.
    - the SDHCI CAPABILITIES register reads as zero on this silicon;
      capability values are hardcoded by the driver.

  On Pi 3 / Pi Zero 2 W this is the SDIO port wired to the CYW43439
  wireless chip. The legacy SDHOST controller (brcm,bcm2835-sdhost,
  not yet supported) drives the SD card on those boards.

compatible: "brcm,bcm2835-sdhci"

include: [sdhc.yaml, pinctrl-device.yaml]

properties:
  reg:
    required: true

  interrupts:
    required: true

  clock-frequency:
    type: int
    required: true
    description: |
      Frequency in Hz of clk_emmc, the input clock provided by the
      BCM2835 clock manager. The SDHCI clock divider scales this
      down to the bus SD clock. Typical 100 MHz with core_freq=250
      in config.txt; consult the board doc.

  bus-width:
    type: int
    default: 4
    enum:
      - 1
      - 4
    description: |
      Number of data lines wired between the controller and the
      attached card / chip. The Arasan core does not support 8-bit;
      4-bit is required for the CYW43439 wireless module.
```

## dts/bindings/sdhc/brcm,bcm2835-sdhost.yaml
```yaml
# Copyright (c) 2026 jetpax
# SPDX-License-Identifier: Apache-2.0

description: |
  Broadcom BCM2835 / BCM2710 / BCM2837 legacy SDHost host controller.

  This is the second, non-Arasan SD controller on the BCM283x SoCs --
  proprietary Broadcom register layout (SDCMD / SDARG / SDHSTS / SDEDM
  / SDDATA / SDCDIV at offsets 0x00..0x50), NOT SDHCI-spec. On the Pi
  3 / Pi Zero 2 W it drives the external microSD card slot via GPIO
  48..53 at ALT0. The other SD controller on these SoCs is the Arasan
  SDHCI block (brcm,bcm2835-sdhci) which serves the on-module CYW43439
  wireless chip via GPIO 34..39 at ALT3 -- the two controllers coexist
  on the same SoC and the same board.

compatible: "brcm,bcm2835-sdhost"

include: [sdhc.yaml, pinctrl-device.yaml]

properties:
  reg:
    required: true

  interrupts:
    required: true

  clock-frequency:
    type: int
    required: true
    description: |
      Frequency in Hz of the VPU core clock that feeds the SDHost
      reference. The driver scales this down to the bus SD clock via
      the SDCDIV register. Typical 250 MHz on Pi Zero 2 W with
      core_freq=250 in config.txt.

  bus-width:
    type: int
    default: 4
    enum:
      - 1
      - 4
    description: |
      Number of data lines wired between the controller and the SD
      card. 4-bit is standard for the microSD slot on the Pi family.
```

## dts/bindings/sensor/raspberrypi,bcm2835-vc-thermal.yaml
```yaml
# Copyright (c) 2026 jetpax
# SPDX-License-Identifier: Apache-2.0

description: |
  Raspberry Pi BCM2835/2710 SoC temperature sensor.

  The SoC die temperature is read through the VideoCore firmware
  GET_TEMPERATURE property tag -- the same source as `vcgencmd
  measure_temp`. The sensor owns no registers of its own, so it is
  modelled as a child of the VideoCore firmware node. Exposes
  SENSOR_CHAN_DIE_TEMP.

compatible: "raspberrypi,bcm2835-vc-thermal"

include: base.yaml
```

## dts/bindings/wifi/brcm,bcm43xxx-sdio.yaml
```yaml
# Copyright (c) 2026 jetpax
# SPDX-License-Identifier: Apache-2.0

description: |
    Broadcom BCM43xxx SDIO Wi-Fi (brcmfmac protocol).

    Covers the SDIO-attached Broadcom/Cypress combo chips that share the
    brcmfmac SDPCM+BCDC protocol -- BCM43430A1 on the Pi Zero 2 W /
    CYW43439 module, BCM4334x, etc. Chip identity is read at runtime from
    chipcommon[0] on the AXI/SB backplane; the driver picks firmware/NVRAM
    blobs from that runtime ID, not from the binding.

    The node is a child of an SDHC controller. The driver reaches the
    SDHC parent via DT_INST_PARENT(0).

compatible: "brcm,bcm43xxx-sdio"

include: base.yaml

properties:
  wifi-reg-on-gpios:
    description: |
      Power / regulator-enable GPIO ("WL_REG_ON" on Cypress modules).
      Optional: on boards where the SoC firmware (e.g. the Pi VPU)
      asserts this before Zephyr starts, the driver leaves it alone --
      toggling LOW->HIGH disturbs the chip PMU.
    type: phandle-array

  wifi-host-wake-gpios:
    description: |
      Optional host-wake GPIO. When the chip wants attention it drives
      this line; the driver wakes its RX thread from the IRQ.
      Not wired on Pi Zero 2 W (host-wake is in-band over DAT1, picked
      up when the SDHC driver gains SDIO-IRQ support).
    type: phandle-array

  firmware-name:
    description: |
      Base name of the firmware/NVRAM blobs in linux-firmware naming
      ("brcmfmac43436s-sdio"). Driver appends ".bin"/".txt".
      Phase 4 v1 expects blobs embedded in the driver build; Phase 5
      will resolve against a filesystem path.
    type: string
```

## soc/allwinner/sun50i_h618/Kconfig.defconfig
```kconfig
# Copyright (c) 2026 Khai Do
# SPDX-License-Identifier: Apache-2.0

if SOC_SUN50I_H618

config NUM_IRQS
	default 160

config MP_MAX_NUM_CPUS
	default 4 if SMP

config SYS_CLOCK_HW_CYCLES_PER_SEC
	default $(dt_node_int_prop_int,/timer,clock-frequency)

config STATIC_INIT_GNU
	default y

configdefault UART_NS16550_DW8250_DW_APB
	default y

configdefault UART_NS16550_ACCESS_WORD_ONLY
	default y

endif
```

## soc/brcm/bcm2710/Kconfig
```kconfig
# Copyright (c) 2026 jetpax
# SPDX-License-Identifier: Apache-2.0

config SOC_BCM2710
	select ARM64
	select CPU_CORTEX_A53
	select ARM_ARCH_TIMER if SYS_CLOCK_EXISTS
	select ARM_CUSTOM_INTERRUPT_CONTROLLER
```

## tests/drivers/display/display_read_write/boards/rpi_zero_2w.conf
```kconfig
# Copyright (c) 2026 jetpax
# SPDX-License-Identifier: Apache-2.0

CONFIG_RASPBERRYPI_FIRMWARE=y
CONFIG_BCM2835_FB=y
```
